## components/audio_in_es7210/Kconfig
```kconfig
menu "Audio in ES7210"

    config AUDIO_IN_I2C_SCL_GPIO
        int "I2C SCL GPIO"
        default 5
        help
            ES7210 控制接口 SCL 引脚。

    config AUDIO_IN_I2C_SDA_GPIO
        int "I2C SDA GPIO"
        default 6
        help
            ES7210 控制接口 SDA 引脚。

    config AUDIO_IN_I2S_PORT
        int "I2S port number"
        default 0
        range 0 1
        help
            使用的 I2S 控制器序号。单 I2S 的芯片只能填 0。

    config AUDIO_IN_I2S_MCLK_GPIO
        int "I2S MCLK GPIO"
        default 16

    config AUDIO_IN_I2S_BCLK_GPIO
        int "I2S BCLK GPIO"
        default 17

    config AUDIO_IN_I2S_WS_GPIO
        int "I2S LRCK/WS GPIO"
        default 18

    config AUDIO_IN_I2S_DIN_GPIO
        int "I2S DIN GPIO"
        default 15

    config AUDIO_IN_GAIN_DB
        int "Microphone gain (dB)"
        default 30
        range 0 42
        help
            ES7210 麦克风增益，按 3dB 步进。过高会削顶。

endmenu
```

## components/led_ring_fx/Kconfig
```kconfig
menu "LED ring effects"

    config LRFX_GPIO
        int "WS2812 data GPIO"
        default 4

    config LRFX_LED_COUNT
        int "LED count"
        default 24
        range 1 64

    config LRFX_COLOR_R
        int "Color R"
        default 0
        range 0 255

    config LRFX_COLOR_G
        int "Color G"
        default 0
        range 0 255

    config LRFX_COLOR_B
        int "Color B"
        default 255
        range 0 255

    config LRFX_MAX_BRIGHTNESS
        int "Max brightness"
        default 255
        range 1 255

    config LRFX_GRB_ORDER
        bool "LED data order is GRB"
        default y
        help
            大多数 WS2812/WS2812C 为 GRB；颜色不对时切换此项。

    config LRFX_TRAIL_LEN
        int "Trail length (LEDs)"
        default 6
        range 0 64

    config LRFX_DECAY_MS
        int "Trail decay time (ms)"
        default 450
        range 50 5000

    config LRFX_IDLE_TIMEOUT_MS
        int "Auto off timeout (ms)"
        default 1200
        range 0 10000

endmenu
```

## components/sound_localizer/Kconfig
```kconfig
menu "Sound localizer"

    config SL_MIC_SPACING_MM
        int "Diagonal mic spacing (mm)"
        default 40
        help
            对角两颗麦克风(MIC1-MIC4、MIC2-MIC3)的间距。

    config SL_ANGLE_OFFSET_DEG
        int "Angle offset (deg)"
        default 0
        range -180 180
        help
            安装角度校准，正值为顺时针补偿。

    config SL_CLOCKWISE
        bool "Angle increases clockwise"
        default y
        help
            关闭后角度整体镜像，用于声源与灯带方向相反的情况。

    config SL_VOICE_MIN_DB
        int "Voice trigger level (dBFS)"
        default -40
        range -90 -10

    config SL_VOICE_FLATNESS_X100
        int "Voice spectral flatness max (x100)"
        default 45
        range 5 100
        help
            谱平坦度上限，越小越严格。

    config SL_MIN_CONFIDENCE_X100
        int "Minimum correlation confidence (x100)"
        default 35
        range 5 95

endmenu
```
